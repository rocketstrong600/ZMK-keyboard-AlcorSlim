## boards/shields/Kconfig.defconfig
```kconfig
if SHIELD_ALCOR_SLIM_LEFT

config ZMK_KEYBOARD_NAME
    default "Alcor Slim"

config ZMK_SPLIT_ROLE_CENTRAL
    default y

endif

if SHIELD_ALCOR_SLIM_LEFT || SHIELD_ALCOR_SLIM_RIGHT

config ZMK_SPLIT
    default y

endif
```

## boards/shields/alcor_slim/Kconfig.shield
```kconfig
# No whitespace after the comma or in your part name!
config SHIELD_ALCOR_SLIM_LEFT
    def_bool $(shields_list_contains,alcor_slim_left)

# No whitespace after the comma or in your part name!
config SHIELD_ALCOR_SLIM_RIGHT
    def_bool $(shields_list_contains,alcor_slim_right)
```
